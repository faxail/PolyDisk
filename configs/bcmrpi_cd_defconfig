## configs/bcmrpi_cd_defconfig
```kconfig
CONFIG_NO_HZ=y
CONFIG_HIGH_RES_TIMERS=y
CONFIG_ARCH_MULTI_V6=y
# CONFIG_ARCH_MULTI_V7 is not set
CONFIG_ARCH_BCM=y
CONFIG_ARCH_BCM2835=y
CONFIG_UACCESS_WITH_MEMCPY=y
CONFIG_CMDLINE=""
CONFIG_CPU_FREQ=y
CONFIG_CPU_FREQ_DEFAULT_GOV_PERFORMANCE=y
CONFIG_CPU_FREQ_GOV_ONDEMAND=y
CONFIG_CPUFREQ_DT=y
CONFIG_ARM_RASPBERRYPI_CPUFREQ=y
CONFIG_VFP=y
CONFIG_PM=y
CONFIG_JUMP_LABEL=y
CONFIG_CMA=y
CONFIG_RASPBERRYPI_FIRMWARE=y
CONFIG_BLK_DEV_LOOP=y
CONFIG_BLK_DEV_LOOP_MIN_COUNT=1
CONFIG_USB_DWC2=y
CONFIG_USB_GADGET=y
CONFIG_USB_CONFIGFS=y
CONFIG_USB_CONFIGFS_MASS_STORAGE=y
CONFIG_MMC=y
CONFIG_MMC_BLOCK_MINORS=32
CONFIG_MMC_BCM2835_MMC=y
CONFIG_MMC_BCM2835_DMA=y
CONFIG_MMC_BCM2835_SDHOST=y
CONFIG_NEW_LEDS=y
CONFIG_LEDS_CLASS=y
CONFIG_LEDS_GPIO=y
CONFIG_LEDS_TRIGGERS=y
CONFIG_LEDS_TRIGGER_TIMER=y
CONFIG_LEDS_TRIGGER_HEARTBEAT=y
CONFIG_LEDS_TRIGGER_DEFAULT_ON=y
CONFIG_LEDS_TRIGGER_PANIC=y
CONFIG_LEDS_TRIGGER_ACTPWR=y
CONFIG_DMADEVICES=y
CONFIG_DMA_BCM2835=y
CONFIG_DMA_BCM2708=y
CONFIG_DMABUF_HEAPS=y
CONFIG_DMABUF_HEAPS_SYSTEM=y
CONFIG_DMABUF_HEAPS_CMA=y
CONFIG_STAGING=y
CONFIG_CLK_RASPBERRYPI=y
CONFIG_MAILBOX=y
CONFIG_BCM2835_MBOX=y
CONFIG_RASPBERRYPI_POWER=y
CONFIG_VFAT_FS=y
CONFIG_FAT_DEFAULT_IOCHARSET="ascii"
CONFIG_EXFAT_FS=y
CONFIG_NLS_DEFAULT="utf8"
CONFIG_NLS_CODEPAGE_437=y
CONFIG_NLS_ASCII=y
CONFIG_LSM=""
CONFIG_DMA_CMA=y
CONFIG_CMA_SIZE_MBYTES=5
CONFIG_EXPERT=y
CONFIG_PARTITION_ADVANCED=y

CONFIG_MULTIUSER=n
CONFIG_NAMESPACES=n
CONFIG_NET=n
CONFIG_USB=n
CONFIG_HID=n
CONFIG_USB_HID=n
CONFIG_INPUT=n
CONFIG_INPUT_LEDS=n
CONFIG_INPUT_KEYBOARD=n
CONFIG_INPUT_MOUSE=n
CONFIG_SWAP=n
CONFIG_BPF=n
CONFIG_SHMEM=n
CONFIG_VM_EVENT_COUNTERS=n
CONFIG_BCM2835_SMI=n
CONFIG_SCSI=n
CONFIG_BLK_DEV_BSG=n
CONFIG_HW_RANDOM=n
CONFIG_DEVMEM=n
CONFIG_PWRSEQ_EMMC=n
CONFIG_PWRSEQ_SIMPLE=n
CONFIG_BCM_VIDEOCORE=n
CONFIG_PROC_SYSCTL=n
CONFIG_PROC_PAGE_MONITOR=n
CONFIG_DEBUG_MISC=n
CONFIG_SCHED_DEBUG=n
CONFIG_FTRACE=n
CONFIG_STACKTRACE=n
CONFIG_TRACE_IRQFLAGS=n
CONFIG_TRACING=n
CONFIG_SYSFS_SYSCALL=n
CONFIG_FHANDLE=n
CONFIG_KALLSYMS=n
CONFIG_DNOTIFY=n
CONFIG_INOTIFY_USER=n
CONFIG_FW_LOADER=n
CONFIG_SUSPEND=n
CONFIG_BUG=n
CONFIG_PSI=n
CONFIG_BRCM_CHAR_DRIVERS=n
CONFIG_REGULATOR=n
CONFIG_MQ_IOSCHED_DEADLINE=n
CONFIG_MQ_IOSCHED_KYBER=n
CONFIG_IOSCHED_BFQ=n
CONFIG_BFQ_GROUP_IOSCHED=n
CONFIG_IO_URING=n
CONFIG_EPOLL=n
CONFIG_SIGNALFD=n
CONFIG_TIMERFD=n
CONFIG_EVENTFD=n
CONFIG_FUTEX=n
CONFIG_FUTEX_PI=n
CONFIG_AIO=n
CONFIG_ADVISE_SYSCALLS=n
CONFIG_CACHESTAT_SYSCALL=n
CONFIG_RSEQ=n
CONFIG_ELF_CORE=n
CONFIG_MEMBARRIER=n
CONFIG_CROSS_MEMORY_ATTACH=n
CONFIG_DEVPORT=n
CONFIG_EFI_PARTITION=n
CONFIG_GPIO_CDEV=n
CONFIG_GPIO_RASPBERRYPI_EXP=n
CONFIG_HWMON=n
CONFIG_IOMMU_SUPPORT=n

CONFIG_CC_OPTIMIZE_FOR_PERFORMANCE=y
CONFIG_PREEMPT_NONE=y
CONFIG_ARM_APPENDED_DTB=y
CONFIG_ARM_ATAG_DTB_COMPAT=y

CONFIG_DEFAULT_INIT="/root/init"

CONFIG_KERNEL_GZIP=y
CONFIG_INITRAMFS_COMPRESSION_NONE=y

CONFIG_RD_GZIP=n
CONFIG_RD_BZIP2=n
CONFIG_RD_LZMA=n
CONFIG_RD_XZ=n
CONFIG_RD_LZO=n
CONFIG_RD_LZ4=n
CONFIG_RD_ZSTD=n
```
